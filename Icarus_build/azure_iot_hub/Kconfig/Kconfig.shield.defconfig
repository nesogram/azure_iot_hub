## Icarus_build/azure_iot_hub/Kconfig/Kconfig.shield.defconfig
```kconfig
osource "C:/ncs/Nrf_Projects/azure_iot_hub/boards/shields/*/Kconfig.defconfig"
osource "C:/ncs/v2.9.0/nrf/boards/shields/*/Kconfig.defconfig"
```

## Icarus_build/azure_iot_hub/Kconfig/boards/Kconfig.sysbuild
```kconfig
# Load Sysbuild board Kconfig descriptions.
osource "C:/ncs/v2.9.0/zephyr/boards/actinius/icarus/Kconfig.sysbuild"
```

## Icarus_build/mcuboot/Kconfig/Kconfig.shield
```kconfig
osource "C:/ncs/Nrf_Projects/azure_iot_hub/boards/shields/*/Kconfig.shield"
osource "C:/ncs/v2.9.0/nrf/boards/shields/*/Kconfig.shield"
```

## Thingy_build/Kconfig/boards/Kconfig.sysbuild
```kconfig
# Load Sysbuild board Kconfig descriptions.
osource "C:/ncs/v2.9.0/nrf/boards/nordic/thingy91/Kconfig.sysbuild"
```

## Thingy_build/mcuboot/Kconfig/boards/Kconfig.defconfig
```kconfig
# Load Zephyr board defconfig descriptions.
osource "C:/ncs/v2.9.0/nrf/boards/nordic/thingy91/Kconfig.defconfig"
```
